## conf/bblayers.conf
```bitbake
# POKY_BBLAYERS_CONF_VERSION is increased each time build/conf/bblayers.conf
# changes incompatibly
POKY_BBLAYERS_CONF_VERSION = "2"

BBPATH = "${TOPDIR}"
BBFILES ?= ""

BBLAYERS ?= " \
  /home/lou/Documents/poky-sumo-19.0.1/meta \
  /home/lou/Documents/poky-sumo-19.0.1/meta-poky \
  /home/lou/Documents/poky-sumo-19.0.1/meta-yocto-bsp \
  /home/lou/Documents/poky-sumo-19.0.1/meta-raspberrypi \
  /home/lou/Documents/poky-sumo-19.0.1/meta-custom \
  /home/lou/Documents/poky-sumo-19.0.1/meta-openembedded/meta-oe \
  /home/lou/Documents/poky-sumo-19.0.1/meta-openembedded/meta-python \
  "
```
